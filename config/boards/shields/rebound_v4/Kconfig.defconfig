## config/boards/shields/rebound_v4/Kconfig.defconfig
```kconfig
# Copyright (c) 2020 The ZMK Contributors
# SPDX-License-Identifier: MIT

if SHIELD_REBOUND4

config ZMK_KEYBOARD_NAME
    default "Rebound v4"

endif
```

## config/boards/shields/rebound_v4/Kconfig.shield
```kconfig
# Copyright (c) 2020 The ZMK Contributors
# SPDX-License-Identifier: MIT

config SHIELD_REBOUND4
    def_bool $(shields_list_contains,rebound4)
```
